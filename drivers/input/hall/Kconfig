## drivers/input/hall/Kconfig
```kconfig
# SPDX-License-Identifier: GPL-2.0-only
config INPUT_HALL
	tristate "BBK hall sensor framework"
	depends on INPUT
	help
	  Say Y here to support the BBK hall sensor framework used by the EEBBK S6
	  (P20H130) to position its elevator camera.  It polls the up and the down
	  hall sensor, keeps their recent samples, detects a mechanism that is
	  pushed by hand, and carries the calibration data that the Android daemon
	  writes through /dev/bbk_hall_core.

	  The driver was reconstructed from the vendor kernel binary because the
	  vendor sources are not part of this tree.
```

## drivers/input/touchscreen/nt36xxx/Kconfig
```kconfig
# SPDX-License-Identifier: GPL-2.0-only
#
# Novatek NT36xxx touchscreen driver configuration
#
config TOUCHSCREEN_NT36XXX
	bool "Novatek NT36xxx"
	default n
	---help---
	  NOTE (EEBBK T3 / P22NH220): keep this DISABLED.  The T3 panel node
	  "novatek@62" on i2c-1 is a phantom entry (the T3 ships a FocalTech
	  FT8719 at 1-0038) and this driver's .shutdown callback dereferences a
	  NULL tfa/ts pointer, oopsing inside device_shutdown() (Process init,
	  pc : nvt_ts_shutdown+0x60).  That aborts the restart sequence and the
	  bootloader then falls back to QMMI/DIAG -> Windows shows
	  "Qualcomm HS-USB Diagnostics 900E" and the reboot takes ~100 s.
	help
	  Say Y here if you have a Novatek NT36xxx touchscreen connected
	  to your system.

	  If unsure, say N.
```

## drivers/platform/NH220/Kconfig
```kconfig
config MACH_EEBBK_P22NH220
	tristate "Support for EEBBK P22NH220 (T1/T3)."
	help
	  Enable the support for EEBBK P22NH220 (T1/T3).
```
